AUTOSAR XML (schema 3.0.1)
package /MICROSAR
  bsw implementation GenTool_GenyFblCanBase_Impl: code-generator=cMICROSAR,GENy, programming-language=C, ar-major-version=3, ar-minor-version=0, ar-patch-version=1, vendor-specific-module-def=GenTool_GenyFblCanBase_Def
  module definition GenTool_GenyFblCanBase_Def
    container General
      string UserConfigFile  # If a file path is specified, the file is read and its contents are put at the end of the FBL config file.
      integer ProjectState: default-value=0  # Code that is required for integration/development is automatically removed once the production state is configured. Test FBL_PROJECT_STATE for FBL_INTEGRATION / FBL_PRODUCTION to use this for your own code. Bootloader internal checks are configured according to the current project state: ~~~ Integration ~~~ Choose this state during development/integration of your integration project. This configuration adds internal configuration and user code checks and hence helps you to find configuration errors easily. Errors found will trigger the callback ApplFblFatalError(). A user specific error handling can be added, e.g. flashing Led if no debugger is available (default: while(1){;}); ~~~ Production (default) ~~~ Choose this state when ready for production. Configuration checks are turned off. ~~~ Production (reduced checks) ~~~ Choose this state when ready for production and if you need to minimize code size. Some additional checks will also be disabled in order to reduce code size. The resulting configuration reports NRCs on runtime errors late. This will make it more difficult to analyze errors that occur on production ECUs. It is therefore recommended to configure "Production (default)" if possible.
      boolean EnableStayInBoot: default-value=false  # If activated the FBL waits a specified time before jumping to a valid application. If a special message is received within this time the FBL stays active. This feature is designed for development phase to avoid reflashing the FBL if the application doesn't work properly.
      integer MaxSegmentsPerBlock: default-value=0  # The download of an application can be separated in several segments depending on the linker settings. To store the addresses and lengths of these segments, the FBL uses an array. Enter the maximum number of address segments here.
      boolean MultipleModuls: default-value=true  # This feature enables reprogramming of a certain module or block without changing other modules/blocks.
      boolean EnableSystemCheck: default-value=true  # Enables enhanced error processing. Activate system check to find configuration errors like wrong size of watchdog/diagnostic buffer.
      boolean EnableSleepMode  # Enable sleep mode/power down support for FBL.
      integer SleepTime  # If the sleep mode is enabled and the diagnostic layer does not receive a diagnostic request for the period of time specified with this attribute then the function fbl_ap.c::ApplFblBusSleep() is called.
      boolean EnableApplTask: default-value=true  # If this option is enabled, the bootloader provides function fbl_ap.c::ApplFblTask(). You can add user specific code to this function which will be called cyclically by the bootloader. The actual call cycle is derived from GENy attribute FblTp_Iso/TP call cycle. Note: The task function won't be called during diagnostic service processing.
      boolean EnableFlashBlockCheck: default-value=true  # Enable this feature to check if the download matches the physical Flash areas. Disabling this feature reduces Codesize. NOTE: When using multiple "Device Types" for the "Flash Block Table" this Feature has to be enabled.
      boolean EnableDebugStatus: default-value=true  # When this feature is enabled, the FBL sends more detailed error codes. This feature only works with Vector Flash tools. Use this option to track down integration issues.
      integer HeaderAddress: default-value=0  # This is the start address of the bootloader's FblHeader structure (defined in module fbl_main.c). The bootloader header can be located at an arbitrary address using the provided section #pragma instructions. CAUTION: If the application software uses the FblStart mechanism to enter the bootloader, you have to update fbl_cfg.h on change of the FBL header address!
      integer DiagBufferLength: default-value=255  # This is the size of the RAM buffer which is used to store diagnostic request/response messages. Usually, the download performance will benefit from choosing bigger buffer sizes. The maximum buffer size is 4095 byte.
      integer P2Time: default-value=20  # Specify the P2 diagnostic timeout here. The FBL will always send a response, before P2 expires.
      integer ReloadP3Time: default-value=5000  # P2* diagnostic response pending time. The FBL will send response pending messages while processing long-lasting service requests. Use this option to configure the response pending timing.
      integer S3TimeExtSession: default-value=5000  # Specifiy the S3 diagnostic timeout for the extended session here. Time for the FBL to keep the extended diagnostic session active while not receiving any diagnostic request message.
      integer S3TimeProgSession: default-value=60000  # Specify the S3 diagnostic timeout for the programming session here. Time for the FBL to keep the programming diagnostic session active while not receiving any diagnostic request message.
      integer FillCode: default-value=255  # The gaps between two download segments will be filled with the specified byte code. It's recommended to use an illegal opcode according to the used hardware platform.
      boolean UseOwnMemCpyFunc: default-value=false  # If enabled, the bootloader will use an internal memory copy function instead of the library memcpy() function of the compiler vendor.
      boolean EnableGatewaySupport: default-value=false  # This option is used for bootloaders that are connected to multiple CAN networks and contains a gateway support feature. It controls if the bootloader shall support or not the gateway feature. The gateway feature routes messages from a main network to one or more sub networks, depending on the feature of the gateway support in the bootloader.
      boolean PresencePattern: default-value=false  # Logical blocks and/or application validation is checked using presence patterns at the end of each logical block. If this option is used, the decision if an application is available can be made without loading a memory driver (e.g. Eeprom Emulation or external Eeprom).
      boolean FblStartFunction: default-value=false  # This option provides a user-friendly way to start the bootloader from within the application by using the macro CallFblStart(). PRECONDITIONS: - The FblHeader address is configured correctly (see GENy component FblDrvCan_*). - The application module which uses CallFblStart() includes fbl_def.h (fbl_cfg.h has to be provided, too). Remember to update fbl_cfg.h if the address of FblHeader changes! By disabling this option, the user can gain more influence on how the transition from application to bootloader is done. This is the procedure which has to be followed: - Set a flag in the application software - Issue a reset - Check flag in user adaptable function fbl_apnv.c::ApplFblExtProgRequest() and provide the appropriate return value.
      boolean CommonData: default-value=false  # By enabling this option, the bootloader provides an interface to access (constant) data which is linked with the bootloader. This enables the application software to read e.g. DID values from the same memory location as the bootloader. In particular, this is useful for DIDs that report hardware specific information which doesn't change if the application software is updated. The structure of the common data is completely user specific and can be declared in file comdat.h. The actual structure definition is usually located in file fbl_ap.c. The bootloader stores the address of this structure in the FblHeader. The respective value can be retrieved by using macro GetFblCommonDataPtr(). To access the common data via GetFblCommonDataPtr(), the application software has to include the files fbl_def.h (which itself needs fbl_cfg.h) and comdat.h. For more detailed usage information, please refer to the respective technical reference.
      boolean ResponseAfterReset: default-value=false  # Send the response to a default session request or a reset request after the ECU has been reset. Before the reset, a response pending message is sent by the Bootloader. The actual response has to be sent by the application software or the Bootloader depending on a flag set in non-initialized memory.
      boolean UserSubfunction: default-value=false  # This option can be activated if user specific subfunction parameters have to be supported which are not defined within the OEM specification. If the bootloader receives a request with a supported service identifier and an unknown subfunction parameter, the user adaptable function fbl_apdi.c::ApplDiagUserSubFunction() will be called.
      boolean UserService: default-value=false  # This option can be activated if user specific diagnostic services have to be supported which are not defined within the OEM specification. If the bootloader receives a request with an unsupported service identifier, the user adaptable function fbl_apdi.c::ApplDiagUserService() will be called.
      boolean UserRoutine: default-value=false  # This option can be activated if user specific diagnostic routines have to be supported which are not defined within the OEM specification. If the bootloader receives a request with an unsupported routine ID, the user adaptable function fbl_apdi.c::ApplDiagRoutineControl() will be called.
      boolean Watchdog_Enable: default-value=true  # If this option is enabled, the bootloader provides an API for watchdog service handling. User specific watchdog service code can be added to function fbl_apwd.c::ApplFblWDTrigger().
      integer Watchdog_Time: default-value=1  # If the watchdog service is enabled, the bootloader will call user function fbl_apwd.c::ApplFblWDTrigger() with the specified cycle time.
      integer TimerClock: default-value=20000  # The FBL needs a timebase which is generated by one of the system timers. The timer clock value that has to be configured here is the base frequency for this timer. This value is used to compute the corresponding timer compare/reload and prescaler values for timer hardware initialization. NOTE: If you multiply the frequency with a PLL, you have to multiply this value, too.
      boolean EncryptionMode: default-value=false  # Enabling this option allows for transmission of encrypted data. The data which is received by the bootloader will be decrypted by means of a dedicated decryption module.
      boolean CompressionMode: default-value=false  # Enabling this option allows for transmission of compressed data. The data which is received by the bootloader will be decompressed by means of a dedicated compression module.
      integer ProcBufferSize: default-value=0  # Defines the maximum output buffer size available for handling of preprocessed data, e.g. decryption or decompression.
      boolean TransferDataChecksum: default-value=false  # If enabled the signature verification will take the downloaded data instead of the data written to non-volatile memory (e.g. flash) as input. The transferred data is passed to the hash/checksum calculation before any data processing takes place. E.g. if compressed data is downloaded the signature is calculated over the compressed data and not the uncompressed contents actually written to flash.
      integer SigVerificationLength: default-value=0  # Defines the maximum data length passed to the on-the-fly verification in a single processing cycle.
      boolean AdaptiveDataTransferRcrrp: default-value=false  # Disable to force the transmission of the first RCR-RP (Response Pending) message before starting processing of the download data. If enabled the first RCR-RP will be conditionally send based on the P2 timeout. Requires that a single program operation takes less than P2! Programming time depends on "Write segmentation" and/or "Data processing buffer size" Also applies to times required by on-the-fly signature verification and data processing.
      boolean PipelinedProgramming: default-value=false  # With this feature enabled, the FBL immediately sends a positive response after the reception of a TransferData request, so that the next data transfer can be performed while the previous data block is programmed. The same parallelization applies to the signature calculation over the transfer data in RAM and the decompression/decryption of the received data. In best case only the pure transmission time is required.
      boolean SuspendProgramming: default-value=false  # Memory driver can be suspended in mid-operation by external event.
      integer WriteSegmentation: default-value=0  # Defines the maximum data length passed to the programming routine in a single processing cycle. Used for options "Adaptive RCR-RP for TransferData service" and "Pipelined programming".
      boolean UnalignedDataTransfer: default-value=false  # If enabled the data transferred during download using the TransferData service can be of arbitrary length. Otherwise all data transfers have to be aligned to a multiple of the largest memory write segment size.
      reference FrPhysicalRx [0..1]: origin=Vector Informatik, destination=Pdu  # Connections of the FrTp are shown in this Drop-down list. The chosen connection is used to receive physical diagnostic requests. Usually the Physical Rx and Physical Tx connection is the same (Full-duplex).
      reference FrPhysicalRx2 [0..1]: origin=Vector Informatik, destination=Pdu  # Configure an additional physical FlexRay connection here. The option can allows you to receive both ISO and L4G frames within the Bootloader. Configuration example: FlexRay Physical Rx connection: Choose the physical FrTp connection which uses short FrTp_ISO-Frames Additional FlexRay Physical Rx connection: Choose the physical FrTp connection which uses long FrTp_L4G-Frames
      reference FrFunctionalRx [0..1]: origin=Vector Informatik, destination=Pdu  # Connections of the FrTp are shown in this Drop-down list. The chosen connection is used to receive functional diagnostic requests.
      reference FrPhysicalTx [0..1]: origin=Vector Informatik, destination=Pdu  # Connections of the FrTp are shown in this Drop-down list. The chosen connection is used to send physical diagnostic responses. The connection is also used to send response pendings while flash programming. Usually the Physical Rx and Physical Tx connection is the same (Full-duplex).
      reference FrPhysicalTx2 [0..1]: origin=Vector Informatik, destination=Pdu  # Configure an additional physical FlexRay response connection here. The option can allows you to send responses with the correct TP frame format (ISO or L4G). Configuration example: FlexRay Physical Tx connection: Choose the physical FrTp connection which uses short FrTp_ISO-Frames Additional FlexRay Physical Tx connection: Choose the physical FrTp connection which uses long FrTp_L4G-Frames
    container Fbt
      container Entry [0..*]
        integer MemoryIdentifier: 0..0, default-value=255  # Selects the address space of the defined addresses
        integer StartAddress: default-value=0  # Logical start address of the logical block.
        integer EndAddress: default-value=0  # Logical end address of the logical block.
        string Description  # Short description of this Flash Block
        reference DeviceType [0..1]: destination=Mdt/Entry
        reference LogicalBlock [0..1]: destination=Lbt/Entry
    container Lbt
      container Entry [0..*]
        string Name
        integer BlockIndex: default-value=0
        integer Disposability
        integer HeaderAddress: default-value=0
        integer PresencePatternAddress: default-value=0
        integer MaxReprogAttempts: default-value=0  # Maximum number of reprogramming cycles
        string Description  # Short description of this Logical Block
        string VerificationRam
        string VerificationRom
    container Mdt
      container Entry [0..*]
        string NameOfDeviceType  # Name of the memory device type selectable in the flash block table. The memory device name is used to reference the memory device driver functions.
        integer SegmentSize: default-value=1  # Write segment size of memory device. The write segment size is the smallest entity that can be programmed in one write access. Refer to the memory device specification for this value.
        integer ErasedValue: 0..255, default-value=255  # Erased value of the memory device. The erased value is the memory content after the memory was erased. Refer to the memory device specification for this value.
