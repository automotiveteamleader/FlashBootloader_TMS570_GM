AUTOSAR XML (schema 3.0.1)
package /MICROSAR
  bsw implementation SysService_SecModHis_Impl: code-generator=cMICROSAR,GENy, programming-language=C, ar-major-version=3, ar-minor-version=0, ar-patch-version=1, vendor-specific-module-def=SysService_SecModHis_Def
  module definition SysService_SecModHis_Def
    container General
      integer ConstantForKey: default-value=0  # This is the start address of the bootloader's FblHeader structure (defined in module fbl_main.c). The bootloader header can be located at an arbitrary address using the provided section #pragma instructions. CAUTION: If the application software uses the FblStart mechanism to enter the bootloader, you have to update fbl_cfg.h on change of the FBL header address!
      integer TimeoutForKey: default-value=0  # This is the start address of the bootloader's FblHeader structure (defined in module fbl_main.c). The bootloader header can be located at an arbitrary address using the provided section #pragma instructions. CAUTION: If the application software uses the FblStart mechanism to enter the bootloader, you have to update fbl_cfg.h on change of the FBL header address!
      integer CallCycle: default-value=0  # This is the start address of the bootloader's FblHeader structure (defined in module fbl_main.c). The bootloader header can be located at an arbitrary address using the provided section #pragma instructions. CAUTION: If the application software uses the FblStart mechanism to enter the bootloader, you have to update fbl_cfg.h on change of the FBL header address!
      enumeration CRC: {SIZE_OPTIMIZED, SPEED_OPTIMIZED}, set at link in variant link-time+post-build / pre-compile in variant pre-compile, default-value=NO_WAKEUP  # 0 Size optimized 1 Speed optimized
